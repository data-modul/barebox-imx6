/*
 * Copyright 2011 Freescale Semiconductor, Inc.
 * Copyright 2011 Linaro Ltd.
 * Copyright 2014 Data Modul AG, Silvio Fricke <silvio.fricke@gmail.com>
 *
 * The code contained herein is licensed under the GNU General Public
 * License. You may obtain a copy of the GNU General Public License
 * Version 2 or later at the following locations:
 *
 * http://www.opensource.org/licenses/gpl-license.html
 * http://www.gnu.org/copyleft/gpl.html
 */
/dts-v1/;

#include "imx6dl.dtsi"
#include "imx6qdl-dmo-ppc.dtsi"

/ {
	model = "Data Modul AG eDM-SBC-iMX6-PPC-DL/S-1G";
	compatible = "dmo,imx6dl-ppc", "fsl,imx6dl";

	memory {
		reg = <0x10000000 0x40000000>;
	};
};

/*
 * Copyright 2011 Freescale Semiconductor, Inc.
 * Copyright 2011 Linaro Ltd.
 * Copyright 2014 Data Modul AG, Silvio Fricke <silvio.fricke@gmail.com>
 *
 * The code contained herein is licensed under the GNU General Public
 * License. You may obtain a copy of the GNU General Public License
 * Version 2 or later at the following locations:
 *
 * http://www.opensource.org/licenses/gpl-license.html
 * http://www.gnu.org/copyleft/gpl.html
 */
/dts-v1/;

#include "imx6q.dtsi"
#include "imx6qdl-dmo-ppc.dtsi"

/ {
	model = "Data Modul AG eDM-SBC-iMX6-PPC-Q/D-2G";
	compatible = "dmo,imx6q-ppc", "fsl,imx6q";

	memory {
		reg = <0x10000000 0x80000000>;
	};
};
